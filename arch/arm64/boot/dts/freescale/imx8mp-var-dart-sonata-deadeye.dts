// SPDX-License-Identifier: (GPL-2.0+ OR MIT)
/*
 * Copyright 2026 Variscite Ltd.
 */

#include "imx8mp-var-dart-sonata-basler-isp0.dts"
#include "imx8mp-var-dart-lvds-single-channel.dtsi"
#include "imx8mp-var-dart-panel-tw8846-1280x720.dtsi"

/ {
	model = "Variscite DART-MX8M-PLUS on Deadeye Board";
};


